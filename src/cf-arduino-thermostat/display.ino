#ifdef USE_DISPLAY

#define CF_DISPLAY_WIDTH        128                                                                 // Display width.
#define CF_DISPLAY_HEIGHT       64                                                                  // Display height.
#define CF_DISPLAY_ADDRESS      0x3C                                                                // Display I2C address.

Adafruit_SSD1306 display(CF_DISPLAY_WIDTH, CF_DISPLAY_HEIGHT, &Wire, -1);                           // Display.

/**
 * Display Logo.
 */
static const unsigned char PROGMEM displayLogo[] = {
    0x00, 0x00, 0x00, 0x00, 0x07, 0xfe, 0x00, 0x00, 0xff, 0xff, 0xff, 0xff, 0xe0, 0x00, 0x00, 0x00, 
    0x00, 0x00, 0x00, 0x00, 0x3f, 0xff, 0xc0, 0x00, 0xff, 0xff, 0xff, 0xff, 0xe0, 0x00, 0x00, 0x00, 
    0x00, 0x00, 0x00, 0x01, 0xff, 0xff, 0xf8, 0x00, 0xff, 0xff, 0xff, 0xff, 0xe0, 0x00, 0x00, 0x00, 
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    0x00, 0x00, 0x00, 0x00, 0x00, 0x00, 0x01, 0xf3, 0xc0, 0x00, 0x00, 0x00, 0x00, 0x00, 0x00, 0x00
};

static const unsigned char PROGMEM displayNetworkIcon8x7[] = {
    0b00000001, //        #
    0b00000011, //       ##
    0b00001011, //     # ##
    0b00011011, //    ## ##
    0b01011011, //  # ## ##
    0b11011011, // ## ## ##
    0b11011011  // ## ## ##
};

static const unsigned char PROGMEM displayPhoneIcon8x7[] = {
    0b00000110, //      ## 
    0b11111110, // ####### 
    0b11000110, // ##   ## 
    0b11000110, // ##   ## 
    0b11111110, // #######
    0b11101110, // ### ###
    0b11111110  // #######
};

static const unsigned char PROGMEM displayTemperatureIcon8x7[] = {
    0b00011000, //    ##   
    0b00100100, //   #  #  
    0b00100100, //   #  #  
    0b00100100, //   #  #  
    0b01000010, //  #    # 
    0b01000010, //  #    # 
    0b00111100  //   ####  
};

static const unsigned char PROGMEM displayHumidityIcon8x7[] = {
    0b00010000, //    #    
    0b00111000, //   ###   
    0b01111100, //  #####  
    0b11111010, // ##### # 
    0b11111010, // ##### # 
    0b01111100, //  #####  
    0b00111000  //   ###   
};

static const unsigned char PROGMEM displayWateringIcon8x7[] = {
    0b00001100, //     ##  
    0b01011110, //  # #### 
    0b11111111, // ########
    0b01001001, //  #  #  #
    0b00100100, //   #  #  
    0b10010010, // #  #  # 
    0b00100100  //   #  #  
};

void displayRenderAPPage() {
    
    display.clearDisplay();

    // Draw bitmaps.
    display.drawBitmap(0, 0, displayNetworkIcon8x7, 8, 7, 1);                                       // Network.
    display.drawBitmap(96, 0, displayPhoneIcon8x7, 8, 7, 1);                                        // Things Board.

    // Draw lines.
    display.setCursor(0, 0);                                                                        // Line 1 Size 1
    display.print("  AP STARTED      OFF");

    display.setCursor(0, 24);                                                                       // Line 3 Size 1
    display.print(" SSID: " + getWiFiSSID());

    display.setCursor(0, 32);                                                                       // Line 4 Size 1
    display.print(" PASS: " + getWiFiPass());
    
    display.setCursor(0, 40);                                                                       // Line 5 Size 1
    display.print(" IP: " + getWiFiIP());
    
    display.display();
}

void displayRenderMainPage() {
    display.clearDisplay();
    display.cp437(true);
    
    // Draw bitmaps.
    display.drawBitmap(0, 0, displayNetworkIcon8x7, 8, 7, 1);                                       // Network.
    display.drawBitmap(96, 0, displayPhoneIcon8x7, 8, 7, 1);                                        // Things Board.
    display.drawBitmap(8, 24, displayTemperatureIcon8x7, 8, 7, 1);                                  // Temperature.
    display.drawBitmap(8, 40, displayHumidityIcon8x7, 8, 7, 1);                                     // Humidity.
    
    // Draw lines.
    display.setCursor(0, 0);                                                                        // Line 1 Size 1
    if (!isWiFiConnected()) {
        display.print("  OFFLINE         OFF");
    } else {
        String displaySSID = getWiFiSSID().substring(0, 13);
        for (int i = displaySSID.length(); i < 13; i++) {
            displaySSID += " ";
        }
        display.print("  " + displaySSID + "   ");
        if (isTBConnected()) {
            display.print("ON");
        } else {
            display.print("OFF");
        }
        
        display.setCursor(0, 8);                                                                    // Line 2 Size 1
        display.print("IP: " + getWiFiIP());
    }
    
    String tempC = String(getDHTTemperatureC());
    tempC = tempC.substring(0, tempC.lastIndexOf(".") + 2);
    for (int i = tempC.length(); i < 5; i++) {
        tempC += " ";
    }
    display.setCursor(0, 24);                                                                       // Line 4 Size 1
    display.print("   ");
    display.print(tempC);
    display.write(248);
    display.print("C   ");
    
    String tempF = String(getDHTTemperatureF());
    tempF = tempF.substring(0, tempF.lastIndexOf(".") + 2);
    for (int i = tempF.length(); i < 5; i++) {
        tempF += " ";
    }
    display.print(tempF);
    display.write(248);
    display.print("F");
    
    String humidity = String(getDHTHumidity());
    humidity = humidity.substring(0, humidity.lastIndexOf(".") + 2);
    for (int i = tempF.length(); i < 5; i++) {
        tempF += " ";
    }
    display.setCursor(0, 40);                                                                       // Line 5 Size 1
    display.print("   ");
    display.print(humidity);
    display.print("%");
    
    display.display();
}

/**
 * Start display.
 */
void displayBegin() {
    // SSD1306_SWITCHCAPVCC = generate display voltage from 3.3V internally.
    if(!display.begin(SSD1306_SWITCHCAPVCC, CF_DISPLAY_ADDRESS)) {
        Logger::error("SSD1306 allocation failed");
        for(;;);                                                                                    // Don't proceed, loop forever.
    }
    
    //display.display();                                                                              // Adafruit Logo.
    //delay(2000);                                                                                    // Pause for 2 seconds.

    // Display logo.
    display.clearDisplay();
    display.drawBitmap(0, 0, displayLogo, 128, 64, 1);
    display.display();
    delay(3000);

    // Clear display.
    display.clearDisplay();
    display.setTextSize(1);
    display.setTextColor(WHITE);
}

/**
 * Dispaly loop.
 */
void displayLoop() {
    displayRenderMainPage();
}

#endif
